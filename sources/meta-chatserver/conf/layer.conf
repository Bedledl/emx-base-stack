## sources/meta-chatserver/conf/layer.conf
```bitbake
# We have a conf and classes directory, add to BBPATH
BBPATH .= ":${LAYERDIR}"

# We have recipes-* directories, add to BBFILES
BBFILES += "${LAYERDIR}/recipes-*/*/*.bb \
            ${LAYERDIR}/recipes-*/*/*.bbappend"

BBFILE_COLLECTIONS += "meta-chatserver"
BBFILE_PATTERN_meta-chatserver = "^${LAYERDIR}/"
BBFILE_PRIORITY_meta-chatserver = "40"

LAYERDEPENDS_meta-chatserver = "core meta-multiboot-update meta-common-configs"
LAYERSERIES_COMPAT_meta-chatserver = "dunfell kirkstone"
```
